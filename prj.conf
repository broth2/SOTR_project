## prj.conf
```kconfig
# nothing here
CONFIG_HEAP_MEM_POOL_SIZE=16384
CONFIG_NEWLIB_LIBC=y
```

## src/main.c
```c
/*
 * Joao Castanheira 97512, Nuno Fahla 97631, 12/2022
 * Based on code developed through the semester
 * 
 * 
 *
 * 
 */

#include <zephyr.h>
#include <device.h>
#include "imageProcAlg.c"
#include "cab.c"

/* Size of stack area used by each thread */
#define STACK_SIZE 1024
#define IMG_STACK   33792

#define IMGSIDE 32 /* Square image. Side size, in pixels*/

/* Thread scheduling priority */
#define NEAR_DETECT_PRIO 90
#define OBSTACLE_COUNT_PRIO 8
#define OUTPUT_UPDATE_PRIO 90
#define LOCATION_PRIO 45
#define BUILD_IMG_PRIO 99

/* Therad periodicity (in ms)*/
#define PERIOD_MS  3000

/* Create thread stack space */
K_THREAD_STACK_DEFINE(near_detect_stack, STACK_SIZE);
K_THREAD_STACK_DEFINE(obstacle_count_stack, STACK_SIZE);
K_THREAD_STACK_DEFINE(output_update_stack, STACK_SIZE);
K_THREAD_STACK_DEFINE(location_stack, STACK_SIZE);
K_THREAD_STACK_DEFINE(build_img_stack, IMG_STACK);
  
/* Create variables for thread data */
struct k_thread near_detect_data;
struct k_thread obstacle_count_data;
struct k_thread output_update_data;
struct k_thread location_data;
struct k_thread build_img_data;

/* shared mem vars: */

uint8_t img[32][32];  /* received img */
uint8_t csa_obj = 0;    /* object in csa */
int num_objcts = 0;     /* number of objects in image */
float curr_angle;       /* angle at which the robot is pointing */
int16_t curr_pos;       /* current distance from left border in percentage */
CAB cab_id;             /* ID of cab */

/* Create task IDs */
k_tid_t near_detect_tid;
k_tid_t obstacle_count_tid;
k_tid_t output_update_tid;
k_tid_t location_tid;
k_tid_t build_img_tid;

/* Semaphores for task synch */
struct k_sem near_detect_sem;
struct k_sem obstacle_count_sem;
struct k_sem output_update_sem;
struct k_sem output_update_semD;
struct k_sem location_sem;
struct k_sem build_img_sem;
struct k_mutex shared_mem_mutex;

// Thread code prototypes

void near_detect(void *argA, void *argB, void *argC);
void obstacle_count(void *argA, void *argB, void *argC);
void output_update(void *argA, void *argB, void *argC);
void curr_location(void *argA, void *argB, void *argC);
void build_img(void *argA, void *argB, void *argC);

void main(void) {

    
    /* Welcome message */
    printk("\n\rinit\n\r");
    
    /* Create and init semaphores */
    k_sem_init(&near_detect_sem, 0, 1);
    k_sem_init(&obstacle_count_sem, 0, 1);
    k_sem_init(&output_update_sem, 0, 1);
    k_sem_init(&output_update_semD, 0, 1);
    k_sem_init(&location_sem, 0, 1);
    k_sem_init(&build_img_sem, 0, 1);
    k_mutex_init(&shared_mem_mutex);
    
    /* Create tasks */
    near_detect_tid = k_thread_create(&near_detect_data, near_detect_stack,
        K_THREAD_STACK_SIZEOF(near_detect_stack), near_detect,
        NULL, NULL, NULL, NEAR_DETECT_PRIO, 0, K_NO_WAIT);

    obstacle_count_tid = k_thread_create(&obstacle_count_data, obstacle_count_stack,
        K_THREAD_STACK_SIZEOF(obstacle_count_stack), obstacle_count,
        NULL, NULL, NULL, OBSTACLE_COUNT_PRIO, 0, K_NO_WAIT); 
        

    output_update_tid = k_thread_create(&output_update_data, output_update_stack,
        K_THREAD_STACK_SIZEOF(output_update_stack), output_update,
        NULL, NULL, NULL, OUTPUT_UPDATE_PRIO, 0, K_NO_WAIT); 

    location_tid = k_thread_create(&location_data, location_stack,
        K_THREAD_STACK_SIZEOF(location_stack), curr_location,
        NULL, NULL, NULL, LOCATION_PRIO, 0, K_NO_WAIT);

    build_img_tid = k_thread_create(&build_img_data, build_img_stack,
        K_THREAD_STACK_SIZEOF(build_img_stack), build_img,
        NULL, NULL, NULL, BUILD_IMG_PRIO, 0, K_NO_WAIT); 

    
    return;

} 

/*  Task that detects if obstacles are in the CSA, when new image is 
    received and updates to shared mem variable csa_obj y/n  */
void near_detect(void *argA , void *argB, void *argC){
    printk("A) Near Obstacle Detection Thread init\n\r");
    int first = 1;
    k_sem_take(&near_detect_sem, K_FOREVER);

    while(1){
        //printk("thread A instance released at %lld\n\r", k_uptime_get());

        printk("thread a lock\n");
        k_mutex_lock(&shared_mem_mutex, K_FOREVER);
        if (csaObjects(img)){
            csa_obj = 1;
            // update shared mem through cab
        }else{
            csa_obj = 0;
        }
        k_mutex_unlock(&shared_mem_mutex);
        printk("thread a unlock\n");

        if(first){
            k_sem_give(&obstacle_count_sem);
            k_sem_give(&location_sem);
            first = 0;
        }
    }
    
    // high PRIO
}

/*  Task that counts the number of objects detected, when new
    image is received and updated shared mem variable  */
void obstacle_count(void *argA , void *argB, void *argC){
    printk("B) Obstacle Count in Image Thread\n\r");
    int first = 1;
    k_sem_take(&obstacle_count_sem, K_FOREVER);
    while(1){
        //printk("thread B instance released at %lld\n\r", k_uptime_get());

        // update shared mem through cab
        printk("thread b lock\n");

        k_mutex_lock(&shared_mem_mutex, K_FOREVER);
        num_objcts = obstCount(img);
        k_mutex_unlock(&shared_mem_mutex);
        printk("thread b unlock\n");
        printk("%d obstacles detected\n\r", num_objcts);

        if(first){
            k_sem_give(&output_update_sem);
            first = 0;
        }
    }   

    // apenas imprime as variaveis da memoria partilhada,
    // deve correr quando as outras tarefas ja correram todas
    // lowest PRIO
}

/*  Task that prints orientation, number of objects in 
    the CSA and total objects detected, everytime a new image
    is received. Gets data from shared mem */
void output_update(void *argA , void *argB, void *argC){
    printk("C) Output Update Thread\n\r");
    char csa_obj_bool;

    k_sem_take(&output_update_sem, K_FOREVER);
    k_sem_take(&output_update_semD, K_FOREVER);
    while(1){
        //printk("thread C instance released at %lld\n\r", k_uptime_get());

        // get data of shared mem through cab (curr_angle, csa_obj, num_objcts)
        csa_obj_bool = 'N';
        printk("thread c lock\n");
        
        k_mutex_lock(&shared_mem_mutex, K_FOREVER);
        if (csa_obj != 0)   csa_obj_bool = 'Y';

        printk("\n\r--------- SYSTEM STATE ---------\n\r");
        printk("Current Orientation: %f\n\rObsctacles in CSA: %c\n\rTotal Objects Detected: %d\n\r", curr_angle, csa_obj_bool, num_objcts);
        printk("--------------------------------\n\n\r");
        k_mutex_unlock(&shared_mem_mutex);
        printk("thread c unlock\n");

    }

    // high PRIO
}

/*  Task that calculates current position and facing angle of the
    robot, everytime there is a new image and updates shared mem */
void curr_location(void *argA , void *argB, void *argC){
    printk("D) Orientation and Position Thread\n\r");
    int first = 1;
    k_sem_take(&location_sem, K_FOREVER);
    while(1){
        //printk("thread D instance released at %lld\n\r", k_uptime_get());

        // get address of vars from shared mem through cab(&curr_angle, &curr_pos)
        // this might prove a vulnerability, maybe we should store the values in temp vars(temp_angle/temp_pos) and update shared mem vars' addresses after calculations
        printk("thread d lock\n");
        
        k_mutex_lock(&shared_mem_mutex, K_FOREVER);
        if(guideLineSearch(img, &curr_pos, &curr_angle)) printk("Failed to find guideline...\n\r");
        k_mutex_unlock(&shared_mem_mutex);
        printk("thread d unlock\n");


        if(first){
            k_sem_give(&output_update_semD);
            first = 0;
        }
    }

    // low PRIO
}

void build_img(void *argA , void *argB, void *argC){
    printk("E) Build Image Thread\n\r");
    uint8_t img1[IMGWIDTH][IMGWIDTH]= 
	{	{0x00,0x00,0xFF,0x00,0x00,0x00,0x00,0x00,0x00,0x00,0x00,0x00,0x00,0x00,0x00,0x00,0x00,0x00,0x00,0x00,0x00,0x00,0x00,0x00,0x00,0x00,0x00,0x00,0x00,0x00,0x00,0x00}, 
		{0x00,0x00,0xFF,0x00,0x00,0x00,0x00,0x00,0x00,0x00,0x00,0x00,0x00,0x00,0x00,0x00,0x00,0x00,0x00,0x00,0x00,0x00,0x00,0x00,0x00,0x00,0x00,0x00,0x00,0x00,0x00,0x00}, 
		{0x00,0x00,0xFF,0x00,0x00,0x00,0x00,0x00,0x00,0x00,0x00,0x00,0x00,0x00,0x00,0x00,0x00,0x00,0x00,0x00,0x00,0x00,0x00,0x00,0x00,0x00,0x00,0x00,0x00,0x00,0x00,0x00}, 
		{0x00,0x00,0xFF,0x00,0x00,0x00,0x00,0x00,0x00,0x00,0x00,0x00,0x00,0x00,0x00,0x00,0x00,0x00,0x00,0x00,0x00,0x00,0x00,0x00,0x00,0x00,0x00,0x00,0x00,0x00,0x00,0x00}, 
		{0x00,0x00,0xFF,0x00,0x00,0x00,0x00,0x00,0x00,0x00,0x00,0x00,0x00,0x00,0x00,0x00,0x00,0x00,0x00,0x00,0x00,0x00,0x00,0x00,0x00,0x00,0x00,0x00,0x00,0x00,0x00,0x00}, 
		{0x00,0x00,0xFF,0x00,0x00,0x00,0x00,0x00,0x00,0x00,0x00,0x00,0x00,0x00,0x00,0x00,0x00,0x00,0x00,0x00,0x00,0x00,0x00,0x00,0x00,0x00,0x00,0x00,0x00,0x00,0x00,0x00}, 
		{0x00,0x00,0xFF,0x00,0x00,0x00,0x00,0x00,0x00,0x00,0x00,0x00,0x00,0x00,0x00,0x00,0x00,0x00,0x00,0x00,0x00,0x00,0x00,0x00,0x00,0x00,0x00,0x00,0x00,0x00,0x00,0x00}, 
		{0x00,0x00,0xFF,0x00,0x00,0x00,0x00,0x00,0x00,0x00,0x00,0x00,0x00,0x00,0x00,0x00,0x00,0x00,0x00,0x00,0x00,0x00,0x00,0x00,0x00,0x00,0x00,0x00,0x00,0x00,0x00,0x00}, 
		{0x00,0x00,0xFF,0x00,0x00,0x00,0x00,0x00,0x00,0x00,0x00,0x00,0x00,0x00,0x00,0x00,0x00,0x00,0x00,0x00,0x00,0x00,0x00,0x00,0x00,0x00,0x00,0x00,0x00,0x00,0x00,0x00}, 
		{0x00,0x00,0xFF,0x00,0x00,0x00,0x00,0x00,0x00,0x00,0x00,0x00,0x00,0x00,0x00,0x00,0x00,0x00,0x00,0x00,0x00,0x00,0x00,0x00,0x00,0x00,0x00,0x00,0x00,0x00,0x00,0x00}, 
		{0x00,0x00,0xFF,0x00,0x00,0x00,0x00,0x00,0x00,0x00,0x00,0x00,0x00,0x00,0x00,0x00,0x00,0x00,0x00,0x00,0x00,0x00,0x00,0x00,0x00,0x00,0x00,0x00,0x00,0x00,0x00,0x00}, 
		{0x00,0x00,0xFF,0x00,0x00,0x00,0x00,0x00,0x00,0x00,0x00,0x00,0x00,0x00,0x00,0x00,0x00,0x00,0x00,0x00,0x00,0x00,0x00,0x00,0x00,0x00,0x00,0x00,0x00,0x00,0x00,0x00}, 
		{0x00,0x00,0xFF,0x00,0x00,0x00,0x00,0x00,0x00,0x00,0x00,0x00,0x00,0x00,0x00,0x00,0x00,0x00,0x00,0x00,0x00,0x00,0x00,0x00,0x00,0x00,0x00,0x00,0x00,0x00,0x00,0x00}, 
		{0x00,0x00,0xFF,0x00,0x00,0x00,0x00,0x00,0x00,0x00,0x00,0x00,0x00,0x00,0x00,0x00,0x00,0x00,0x00,0x00,0x00,0x00,0x00,0x00,0x00,0x00,0x00,0x00,0x00,0x00,0x80,0x00}, 
		{0x00,0x00,0xFF,0x00,0x00,0x00,0x00,0x00,0x00,0x00,0x00,0x00,0x00,0x00,0x00,0x00,0x00,0x00,0x00,0x00,0x00,0x00,0x00,0x00,0x00,0x00,0x00,0x00,0x00,0x00,0x00,0x00}, 
		{0x00,0x00,0xFF,0x00,0x00,0x00,0x00,0x00,0x00,0x00,0x00,0x00,0x00,0x00,0x00,0x00,0x00,0x00,0x00,0x00,0x00,0x00,0x00,0x00,0x00,0x00,0x00,0x00,0x00,0x00,0x00,0x00}, 
		{0x00,0x00,0xFF,0x00,0x00,0x00,0x00,0x00,0x00,0x00,0x00,0x00,0x00,0x00,0x00,0x00,0x00,0x00,0x00,0x00,0x00,0x00,0x00,0x00,0x00,0x00,0x00,0x00,0x00,0x00,0x00,0x00}, 
		{0x00,0x00,0xFF,0x00,0x80,0x00,0x00,0x00,0x00,0x00,0x00,0x00,0x00,0x00,0x00,0x00,0x00,0x00,0x00,0x00,0x00,0x00,0x00,0x00,0x00,0x00,0x00,0x00,0x00,0x00,0x00,0x00}, 
		{0x00,0x00,0xFF,0x00,0x00,0x00,0x00,0x00,0x00,0x00,0x00,0x00,0x00,0x00,0x00,0x00,0x00,0x00,0x00,0x00,0x00,0x00,0x00,0x00,0x00,0x00,0x00,0x00,0x00,0x00,0x00,0x00}, 
		{0x00,0x00,0xFF,0x00,0x00,0x00,0x00,0x00,0x00,0x00,0x00,0x00,0x00,0x00,0x00,0x00,0x00,0x00,0x00,0x00,0x00,0x00,0x00,0x00,0x00,0x00,0x00,0x00,0x00,0x00,0x00,0x00}, 
		{0x00,0x00,0xFF,0x00,0x00,0x00,0x00,0x00,0x00,0x00,0x00,0x00,0x00,0x00,0x00,0x00,0x00,0x00,0x00,0x00,0x00,0x00,0x00,0x00,0x00,0x00,0x00,0x00,0x00,0x00,0x00,0x00}, 
		{0x00,0x00,0xFF,0x00,0x00,0x00,0x00,0x00,0x00,0x00,0x00,0x00,0x00,0x00,0x00,0x00,0x00,0x00,0x00,0x00,0x00,0x00,0x00,0x00,0x00,0x00,0x00,0x00,0x00,0x00,0x00,0x00}, 
		{0x00,0x00,0xFF,0x00,0x00,0x00,0x00,0x00,0x00,0x00,0x00,0x00,0x00,0x00,0x00,0x00,0x00,0x00,0x00,0x00,0x00,0x00,0x00,0x00,0x00,0x00,0x00,0x00,0x00,0x00,0x00,0x00}, 
		{0x00,0x00,0xFF,0x00,0x00,0x00,0x00,0x00,0x00,0x00,0x00,0x00,0x00,0x00,0x00,0x00,0x00,0x00,0x00,0x00,0x00,0x00,0x00,0x00,0x00,0x00,0x00,0x00,0x00,0x00,0x00,0x00}, 
		{0x00,0x00,0xFF,0x00,0x00,0x00,0x80,0x00,0x00,0x00,0x00,0x00,0x00,0x00,0x00,0x00,0x00,0x00,0x00,0x00,0x00,0x00,0x00,0x00,0x00,0x00,0x00,0x00,0x00,0x00,0x00,0x00}, 
		{0x00,0x00,0xFF,0x00,0x00,0x00,0x00,0x00,0x00,0x00,0x00,0x00,0x00,0x00,0x00,0x00,0x00,0x00,0x00,0x00,0x00,0x00,0x00,0x00,0x00,0x00,0x00,0x00,0x00,0x00,0x00,0x00}, 
		{0x00,0x00,0xFF,0x00,0x00,0x00,0x00,0x00,0x00,0x00,0x00,0x00,0x00,0x00,0x00,0x00,0x00,0x00,0x00,0x00,0x00,0x00,0x00,0x00,0x00,0x00,0x00,0x00,0x80,0x00,0x00,0x00}, 
		{0x00,0x00,0xFF,0x00,0x00,0x00,0x00,0x00,0x00,0x00,0x00,0x00,0x00,0x00,0x00,0x00,0x00,0x00,0x00,0x00,0x00,0x00,0x00,0x00,0x00,0x00,0x00,0x00,0x00,0x00,0x00,0x00}, 
		{0x00,0x00,0xFF,0x00,0x00,0x00,0x00,0x00,0x00,0x00,0x00,0x00,0x00,0x00,0x00,0x80,0x00,0x00,0x00,0x00,0x00,0x00,0x00,0x00,0x00,0x00,0x00,0x00,0x00,0x00,0x00,0x00}, 
		{0x00,0x00,0xFF,0x00,0x00,0x00,0x00,0x00,0x00,0x00,0x00,0x00,0x00,0x00,0x00,0x00,0x00,0x00,0x00,0x00,0x00,0x00,0x00,0x00,0x00,0x80,0x00,0x00,0x00,0x00,0x00,0x00}, 
		{0x00,0x00,0xFF,0x00,0x00,0x00,0x00,0x00,0x00,0x00,0x00,0x00,0x00,0x00,0x00,0x00,0x00,0x00,0x00,0x00,0x00,0x00,0x00,0x00,0x00,0x00,0x00,0x00,0x00,0x00,0x00,0x00}, 
		{0x00,0x00,0xFF,0x00,0x00,0x00,0x00,0x00,0x00,0x00,0x00,0x00,0x80,0x00,0x00,0x00,0x00,0x00,0x00,0x00,0x00,0x00,0x00,0x00,0x00,0x00,0x00,0x00,0x00,0x00,0x00,0x00} 
		};

    uint8_t img2[IMGWIDTH][IMGWIDTH]= 
	{	{0x00,0x00,0x00,0x00,0x00,0x00,0x00,0x00, 0x00,0x00,0x00,0x00,0x00,0x00,0x00,0x00,0x00,0x00,0x00,0x00,0x00,0x00,0x00,0x00, 0x00,0xFF,0x00,0x00,0x00,0x00,0x00,0x00}, 
		{0x00,0x00,0x00,0x00,0x00,0x00,0x00,0x00, 0x00,0x00,0x00,0x00,0x00,0x00,0x00,0x00,0x00,0x00,0x00,0x00,0x00,0x00,0x00,0x00, 0xFF,0x00,0x00,0x00,0x00,0x00,0x00,0x00}, 
		{0x00,0x00,0x00,0x00,0x00,0x00,0x00,0x00, 0x00,0x00,0x00,0x00,0x00,0x00,0x00,0x00,0x00,0x00,0x00,0x00,0x00,0x00,0x00,0xFF, 0x00,0x00,0x00,0x00,0x00,0x00,0x00,0x00}, 
		{0x00,0x00,0x00,0x00,0x00,0x00,0x00,0x00, 0x00,0x00,0x00,0x00,0x00,0x00,0x00,0x00,0x00,0x00,0x00,0x00,0x00,0x00,0xFF,0x00, 0x00,0x00,0x00,0x00,0x00,0x00,0x00,0x00}, 
		{0x00,0x00,0x00,0x00,0x00,0x00,0x00,0x00, 0x00,0x00,0x00,0x00,0x00,0x00,0x00,0x00,0x00,0x00,0x00,0x00,0x00,0x00,0xFF,0x00, 0x00,0x00,0x00,0x00,0x00,0x00,0x00,0x00}, 
		{0x00,0x00,0x00,0x00,0x00,0x00,0x00,0x00, 0x00,0x00,0x00,0x00,0x00,0x00,0x00,0x00,0x00,0x00,0x00,0x00,0x00,0x00,0xFF,0x00, 0x00,0x00,0x00,0x00,0x00,0x00,0x00,0x00}, 
		{0x00,0x00,0x00,0x00,0x00,0x00,0x00,0x00, 0x00,0x00,0x00,0x00,0x00,0x00,0x00,0x00,0x00,0x00,0x00,0x00,0x00,0x00,0xFF,0x00, 0x00,0x00,0x00,0x00,0x00,0x00,0x00,0x00}, 
		{0x00,0x00,0x00,0x00,0x00,0x00,0x00,0x00, 0x00,0x00,0x00,0x00,0x00,0x00,0x00,0x00,0x00,0x00,0x00,0x00,0x00,0xFF,0x00,0x00, 0x00,0x00,0x00,0x00,0x00,0x00,0x00,0x00}, 
		{0x00,0x00,0x80,0x00,0x00,0x00,0x00,0x00, 0x00,0x00,0x00,0x00,0x00,0x00,0x00,0x00,0x00,0x00,0x00,0x00,0x00,0xFF,0x00,0x00, 0x00,0x00,0x00,0x00,0x00,0x00,0x00,0x00}, 
		{0x00,0x00,0x00,0x00,0x00,0x00,0x00,0x00, 0x00,0x00,0x00,0x00,0x80,0x00,0x00,0x00,0x00,0x00,0x00,0x00,0xFF,0x00,0x00,0x00, 0x00,0x00,0x00,0x00,0x00,0x00,0x00,0x00}, 
		{0x00,0x00,0x00,0x00,0x00,0x00,0x00,0x00, 0x00,0x00,0x00,0x00,0x00,0x00,0x00,0x00,0x00,0x00,0x00,0xFF,0x00,0x00,0x00,0x00, 0x00,0x00,0x00,0x00,0x00,0x00,0x00,0x00}, 
		{0x00,0x00,0x00,0x00,0x00,0x00,0x00,0x00, 0x00,0x00,0x00,0x00,0x00,0x00,0x00,0x00,0x00,0x00,0x00,0xFF,0x00,0x00,0x00,0x00, 0x00,0x00,0x80,0x00,0x00,0x00,0x00,0x00}, 
		{0x00,0x00,0x00,0x00,0x00,0x00,0x00,0x00, 0x00,0x00,0x00,0x00,0x00,0x00,0x00,0x00,0x00,0x00,0x00,0xFF,0x00,0x00,0x00,0x00, 0x00,0x00,0x00,0x00,0x00,0x00,0x00,0x00}, 
		{0x00,0x00,0x00,0x00,0x00,0x00,0x00,0x00, 0x00,0x00,0x00,0x00,0x00,0x00,0x00,0x00,0x00,0x00,0x00,0xFF,0x00,0x00,0x00,0x00, 0x00,0x00,0x00,0x00,0x00,0x00,0x80,0x00}, 
		{0x00,0x00,0x00,0x00,0x00,0x00,0x00,0x00, 0x00,0x00,0x00,0x00,0x00,0x00,0x00,0x00,0x00,0x00,0xFF,0x00,0x00,0x00,0x00,0x00, 0x00,0x00,0x00,0x00,0x00,0x00,0x00,0x00}, 
		{0x00,0x00,0x00,0x00,0x00,0x00,0x00,0x00, 0x00,0x00,0x00,0x00,0x00,0x00,0x00,0x00,0x00,0x00,0xFF,0x00,0x00,0x00,0x00,0x00, 0x00,0x00,0x00,0x00,0x00,0x00,0x00,0x00}, 
		
        {0x00,0x00,0x00,0x00,0x00,0x00,0x00,0x00, 0x00,0x00,0x00,0x00,0x00,0x00,0x00,0x00,0x00,0xFF,0x00,0x00,0x00,0x00,0x00,0x00, 0x00,0x00,0x00,0x00,0x00,0x00,0x00,0x00}, 
		{0x00,0x00,0x00,0x00,0x80,0x00,0x00,0x00, 0x00,0x00,0x00,0x00,0x00,0x00,0x00,0x00,0x00,0xFF,0x00,0x00,0x00,0x00,0x00,0x00, 0x00,0x00,0x00,0x00,0x00,0x00,0x00,0x00}, 
		{0x00,0x00,0x00,0x00,0x00,0x00,0x00,0x00, 0x00,0x00,0x00,0x00,0x00,0x00,0x00,0x00,0xFF,0x00,0x00,0x00,0x00,0x00,0x00,0x00, 0x00,0x00,0x00,0x00,0x00,0x00,0x00,0x00}, 
		{0x00,0x00,0x00,0x00,0x00,0x00,0x00,0x00, 0x00,0x00,0x00,0x00,0x00,0x00,0x00,0x00,0xFF,0x00,0x00,0x00,0x00,0x00,0x00,0x00, 0x00,0x00,0x00,0x00,0x00,0x00,0x00,0x00}, 
		{0x00,0x00,0x00,0x00,0x00,0x00,0x00,0x00, 0x00,0x00,0x00,0x00,0x00,0x00,0x00,0xFF,0x00,0x00,0x00,0x00,0x00,0x00,0x00,0x00, 0x00,0x00,0x00,0x00,0x00,0x00,0x00,0x00}, 
		{0x00,0x00,0x00,0x00,0x00,0x00,0x00,0x00, 0x00,0x00,0x00,0x00,0x00,0x00,0x00,0xFF,0x00,0x00,0x00,0x00,0x00,0x00,0x00,0x00, 0x00,0x00,0x00,0x00,0x00,0x00,0x00,0x00}, 
		{0x00,0x00,0x00,0x00,0x00,0x00,0x00,0x00, 0x00,0x00,0x00,0x00,0x00,0x00,0xFF,0x00,0x00,0x00,0x00,0x00,0x00,0x00,0x00,0x00, 0x00,0x00,0x80,0x00,0x00,0x00,0x00,0x00}, 
		{0x00,0x00,0x80,0x00,0x80,0x00,0x00,0x00, 0x00,0x00,0x00,0x00,0x00,0x00,0xFF,0x00,0x00,0x00,0x00,0x00,0x00,0x00,0x00,0x00, 0x00,0x00,0x00,0x00,0x00,0x00,0x00,0x00}, 
		{0x00,0x00,0x00,0x00,0x00,0x00,0x80,0x00, 0x00,0x00,0x00,0x00,0x00,0xFF,0x00,0x00,0x00,0x00,0x00,0x00,0x00,0x00,0x00,0x00, 0x00,0x00,0x00,0x00,0x00,0x00,0x00,0x00}, 
		{0x00,0x00,0x00,0x00,0x00,0x00,0x00,0x00, 0x00,0x00,0x00,0x00,0x00,0xFF,0x00,0x00,0x00,0x00,0x00,0x00,0x00,0x00,0x00,0x00, 0x00,0x00,0x00,0x00,0x00,0x00,0x00,0x00}, 
		{0x00,0x00,0x00,0x00,0x00,0x00,0x00,0x00, 0x00,0x00,0x00,0x00,0xFF,0x00,0x00,0x00,0x00,0x00,0x00,0x00,0x00,0x00,0x00,0x00, 0x00,0x00,0x00,0x00,0x80,0x00,0x00,0x00}, 
		{0x00,0x00,0x00,0x00,0x00,0x00,0x00,0x00, 0x00,0x00,0x00,0x00,0xFF,0x00,0x00,0x00,0x00,0x00,0x00,0x00,0x00,0x00,0x00,0x00, 0x00,0x00,0x00,0x00,0x00,0x00,0x00,0x00}, 
		{0x00,0x00,0x00,0x00,0x00,0x00,0x00,0x00, 0x00,0x00,0x00,0x00,0xFF,0x00,0x00,0x80,0x00,0x00,0x00,0x00,0x00,0x00,0x00,0x00, 0x00,0x00,0x00,0x00,0x00,0x00,0x00,0x00}, 
		{0x00,0x00,0x00,0x00,0x00,0x00,0x00,0x00, 0x00,0x00,0x00,0xFF,0x00,0x00,0x00,0x00,0x00,0x00,0x00,0x00,0x00,0x00,0x00,0x00, 0x00,0x80,0x00,0x00,0x00,0x00,0x00,0x00}, 
		{0x00,0x00,0x00,0x00,0x00,0x00,0x00,0x00, 0x00,0x00,0x00,0xFF,0x00,0x00,0x00,0x00,0x00,0x00,0x00,0x00,0x00,0x00,0x00,0x00, 0x00,0x00,0x00,0x00,0x00,0x00,0x00,0x00}, 
		{0x00,0x00,0x00,0x00,0x00,0x00,0x00,0x00, 0x00,0x00,0xFF,0x00,0x80,0x00,0x00,0x00,0x00,0x00,0x00,0x00,0x00,0x00,0x00,0x00, 0x00,0x00,0x00,0x00,0x00,0x00,0x00,0x00} 
		};
    printk("\n\n");
    int64_t fin_time=0, release_time=0;
    int curr_img = 1;
    int first = 1;

    release_time = k_uptime_get() + PERIOD_MS;
    while(1){
        printk("thread E instance released at %lld\n\r", k_uptime_get());

        if (curr_img==1){
            printk("thread e lock\n");

            k_mutex_lock(&shared_mem_mutex, K_FOREVER);
            for(int i = 0; i<IMGWIDTH; i++){
                for(int j = 0; j<IMGWIDTH; j++){
                    img[i][j]=img1[i][j];
                }   
            }
            k_mutex_unlock(&shared_mem_mutex);
            printk("thread e unlock\n");
            curr_img=2;
        }else{
            printk("thread e lock\n");
            k_mutex_lock(&shared_mem_mutex, K_FOREVER);
            for(int i = 0; i<IMGWIDTH; i++){
                for(int j = 0; j<IMGWIDTH; j++){
                    img[i][j]=img2[i][j];
                }   
            }
            k_mutex_unlock(&shared_mem_mutex);
            printk("thread e unlock\n");
            curr_img=1;
        }

        if(first) {
            k_sem_give(&near_detect_sem);
            first = 0;
        }

        fin_time = k_uptime_get();
        printk("Task E exec time: %llu\n", fin_time-release_time);
        if( fin_time < release_time) {
            k_msleep(release_time - fin_time);
            release_time += PERIOD_MS;
        }
    }
}
```

## src/cab.c
```c
#include <stdint.h>
#include "cab.h"

/* structure of CAB buffers  */
struct buffer{		
    struct buffer *next;	
    unsigned char link_counter;
};	


/* structure of CAB  */
struct CAB_struct{
    char name[10]; /* CAB name*/
    int num; /*number of buffers*/
    int num_free_buffers; /*number of free buffers*/
    int dim; /*message dimension*/
    struct buffer *free; /*pointer to first free buffer*/
    struct buffer *last_used; /*pointer to most recent data*/
};



static struct   CAB_struct  cabs[1];
/* returns a CAB*/
CAB open_cab(char *name,int num,int dim,char* first){
    printf("\n----OPEN CAB----\n");
    CAB ret = 0;
    struct CAB_struct *cab = &cabs[0] ; /* to return the data where the CAB is descripted*/
    /* Verifies if size vars are correct*/
    if(num < 1 || dim < 1){
        fprintf(stderr,"INVALID CAB DIMENSIONS\n");
        return -1;
    }
    /*Allocate memory to the CAB buffers*/

    /*cabmem_init stores the pointer to the first buffer in the CAB */
    char *first_buffer = k_malloc(num * (sizeof(struct buffer) + dim)); 

    /* Copy args to struct CAB*/
    strcpy(cab->name,name);
    cab->num =num;

    cab->dim = dim;

    /* Handle first message and store in first buffer*/
    cab->last_used = (struct buffer*)first_buffer;
    printf("Buffer 0: %p\n", cab->last_used);
    /*pointer to the first buffer*/
    
    /* Store first message in first buffer with memcpy*/
    struct buffer* aux = (struct buffer*) first_buffer;
    
    

    /*initialize the buffers*/
    for(int i = 1; i<=num;i++){
        char* next_buf = first_buffer +(i* (sizeof(struct buffer) + dim));
        
        aux->next = (struct buffer*)next_buf;
        aux->link_counter = 0;
        aux = (struct buffer*)next_buf;
        printf("Buffer %d: %p\n", i,next_buf);
    }
    
    
    aux->next = NULL;
    /*fill the rest of the CAB struct*/
    cab->free = cab->last_used->next;
    char *ptr = memcpy(first_buffer + sizeof(struct buffer),first,dim);
    printf("message pointer %p\n",ptr);
    /* Update number of free buffers*/
    cab->num_free_buffers = cab->num - 1;
    printf("LAST USED: %p\n", cab->last_used);

    return ret;
}

char *reserve(CAB id){
    /* Get the pointer to the cab*/
    struct CAB_struct *cab = &cabs[id];

    /*Check if there are free buffers (link_counter < 5)*/
    if(cab->num_free_buffers != 0){
        /*Get buffer free list */
        cab->num_free_buffers--;
        /* chosen buffer is char in order to comply with function type
        Other wise it would be struct_buffer*/
        char* chosen_buffer = (char *)cab->free;

        /*Update free buffer to the next*/
        cab->free = cab->free->next;
        return chosen_buffer;
    }else{
        return(NULL);
    }
   
}

void put_mes(char *buf_pointer,CAB id){

    printf("----PUT MSG----\n");
    /* Get the pointer to the cab*/
    struct CAB_struct *cab = &cabs[id];
    struct buffer* old_last_used;
    
    /*Get the last used to update with new values*/
    /*Due to CAB properties we always want the data in the last_used buffer*/
    old_last_used = cab->last_used;
    /*if no one is writing or reading*/
    if(old_last_used->link_counter == 0){ 
        /*Update old_last used*/
        old_last_used->next = cab->free;
        cab->free = old_last_used;
        /* Add one free buffer*/
        cab->num_free_buffers++;

    }
    /*Set the last used as the buffer that we reserved*/
    cab->last_used = (struct buffer*) buf_pointer;
    printf("LAST USED: %p\n", cab->last_used);

}

char* cab_getmes(CAB id){
    printf("----GET MSG----\n");
    struct CAB_struct *cab = &cabs[id];
    /*Increase link_counter while that data is being used*/
    cab->last_used->link_counter++;
    printf("last used get mes: %p\n",(char*)cab->last_used + sizeof(struct buffer));
    return (char*)cab->last_used + sizeof(struct buffer);

}

void cab_unget(char* mes_pointer, CAB id){
    printf("----GET MSG----\n");
    struct CAB_struct *cab = &cabs[id];
    printf("msg_pointer: %p\n", mes_pointer);
    /*get the buffer pointer from the mes_pointer*/
    struct buffer* buffer_pointer = (struct buffer*)(mes_pointer - sizeof(struct buffer));

    /*Unlink buffer*/

    buffer_pointer->link_counter--;
    /* If no one else is using te buffer*/
    if((buffer_pointer->link_counter == 0) && (buffer_pointer != cab->last_used)){
        buffer_pointer->next = cab->free;
        cab->free = buffer_pointer;
        cab->num_free_buffers++;
    }
    
    printf("UNGET BUFFER: %p\n", buffer_pointer);
}

//  int main() {
//     uint8_t img1[32*32]= 
// 	{	0x00,0x00,0x00,0x00,0x00,0x00,0x00,0x00,0x00,0x00,0x00,0x00,0x00,0x00,0x00,0x00,0x00,0x00,0x00,0x00,0x00,0x00,0x00,0x00,0x00,0x00,0x00,0x00,0x00,0x00,0x00,0x00,0x00,0x00,0x00,0x00,0x00,0x00,0x00,0x00,0x00,0x00,0x00,0x00,0x00,0x00,0x00,0x00,0x00,0x00,0x00,0x00,0x00,0x00,0x00,0x00,0x00,0x00,0x00,0x00,0x00,0x00,0x00,0x00,0x00,0x00,0x00,0x00,0x00,0x00,0x00,0x00,0x00,0x00,0x00,0x00,0x00,0x00,0x00,0x00,0x00,0x00,0x00,0x00,0x00,0x00,0x00,0x00,0x00,0x00,0x00,0x00,0x00,0x00,0x00,0x00,0x00,0x00,0xFF,0x00,0x00,0x00,0x00,0x00,0x00,0x00,0x00,0x00,0x00,0x00,0x00,0x00,0x00,0x00,0x00,0x00,0x00,0x00,0x00,0x00,0x00,0x00,0x00,0x00,0x00,0x00,0x00,0x00, 
// 		0x00,0x00,0x00,0x00,0x00,0x00,0x00,0x00,0x00,0x00,0x00,0x00,0x00,0x00,0x00,0x00,0x00,0x00,0x00,0x00,0x00,0x00,0x00,0x00,0x00,0x00,0x00,0x00,0x00,0x00,0x00,0x00,0x00,0x00,0x00,0x00,0x00,0x00,0x00,0x00,0x00,0x00,0x00,0x00,0x00,0x00,0x00,0x00,0x00,0x00,0x00,0x00,0x00,0x00,0x00,0x00,0x00,0x00,0x00,0x00,0x00,0x00,0x00,0x00,0x00,0x00,0x00,0x00,0x00,0x00,0x00,0x00,0x00,0x00,0x00,0x00,0x00,0x00,0x00,0x00,0x00,0x00,0x00,0x00,0x00,0x00,0x00,0x00,0x00,0x00,0x00,0x00,0x00,0x00,0x00,0x00,0x00,0x00,0xFF,0x00,0x00,0x00,0x00,0x00,0x00,0x00,0x00,0x00,0x00,0x00,0x00,0x00,0x00,0x00,0x00,0x00,0x00,0x00,0x00,0x00,0x00,0x00,0x00,0x00,0x00,0x00,0x00,0x00, 
// 		0x00,0x00,0x00,0x00,0x00,0x00,0x00,0x00,0x00,0x00,0x00,0x00,0x00,0x00,0x00,0x00,0x00,0x00,0x00,0x00,0x00,0x00,0x00,0x00,0x00,0x00,0x00,0x00,0x00,0x00,0x00,0x00,0x00,0x00,0x00,0x00,0x00,0x00,0x00,0x00,0x00,0x00,0x00,0x00,0x00,0x00,0x00,0x00,0x00,0x00,0x00,0x00,0x00,0x00,0x00,0x00,0x00,0x00,0x00,0x00,0x00,0x00,0x00,0x00,0x00,0x00,0x00,0x00,0x00,0x00,0x00,0x00,0x00,0x00,0x00,0x00,0x00,0x00,0x00,0x00,0x00,0x00,0x00,0x00,0x00,0x00,0x00,0x00,0x00,0x00,0x00,0x00,0x00,0x00,0x00,0x00,0x00,0x00,0xFF,0x00,0x00,0x00,0x00,0x00,0x00,0x00,0x00,0x00,0x00,0x00,0x00,0x00,0x00,0x00,0x00,0x00,0x00,0x00,0x00,0x00,0x00,0x00,0x00,0x00,0x00,0x00,0x00,0x00, 
// 		0x00,0x00,0x00,0x00,0x00,0x00,0x00,0x00,0x00,0x00,0x00,0x00,0x00,0x00,0x00,0x00,0x00,0x00,0x00,0x00,0x00,0x00,0x00,0x00,0x00,0x00,0x00,0x00,0x00,0x00,0x00,0x00,0x00,0x00,0x00,0x00,0x00,0x00,0x00,0x00,0x00,0x00,0x00,0x00,0x00,0x00,0x00,0x00,0x00,0x00,0x00,0x00,0x00,0x00,0x00,0x00,0x00,0x00,0x00,0x00,0x00,0x00,0x00,0x00,0x00,0x00,0x00,0x00,0x00,0x00,0x00,0x00,0x00,0x00,0x00,0x00,0x00,0x00,0x00,0x00,0x00,0x00,0x00,0x00,0x00,0x00,0x00,0x00,0x00,0x00,0x00,0x00,0x00,0x00,0x00,0x00,0x00,0x00,0xFF,0x00,0x00,0x00,0x00,0x00,0x00,0x00,0x00,0x00,0x00,0x00,0x00,0x00,0x00,0x00,0x00,0x00,0x00,0x00,0x00,0x00,0x00,0x00,0x00,0x00,0x00,0x00,0x00,0x00, 
// 		0x00,0x00,0x00,0x00,0x00,0x00,0x00,0x00,0x00,0x00,0x00,0x00,0x00,0x00,0x00,0x00,0x00,0x00,0x00,0x00,0x00,0x00,0x00,0x00,0x00,0x00,0x00,0x00,0x00,0x00,0x00,0x00,0x00,0x00,0x00,0x00,0x00,0x00,0x00,0x00,0x00,0x00,0x00,0x00,0x00,0x00,0x00,0x00,0x00,0x00,0x00,0x00,0x00,0x00,0x00,0x00,0x00,0x00,0x00,0x00,0x00,0x00,0x00,0x00,0x00,0x00,0x00,0x00,0x00,0x00,0x00,0x00,0x00,0x00,0x00,0x00,0x00,0x00,0x00,0x00,0x00,0x00,0x00,0x00,0x00,0x00,0x00,0x00,0x00,0x00,0x00,0x00,0x00,0x00,0x00,0x00,0x00,0x00,0xFF,0x00,0x00,0x00,0x00,0x00,0x00,0x00,0x00,0x00,0x00,0x00,0x00,0x00,0x00,0x00,0x00,0x00,0x00,0x00,0x00,0x00,0x00,0x00,0x00,0x00,0x00,0x00,0x00,0x00, 
// 		0x00,0x00,0x00,0x00,0x00,0x00,0x00,0x00,0x00,0x00,0x00,0x80,0x00,0x00,0x00,0x00,0x00,0x00,0x00,0x00,0x00,0x00,0x00,0x00,0x00,0x00,0x00,0x00,0x00,0x00,0x00,0x00,0x00,0x00,0x00,0x00,0x00,0x00,0x00,0x00,0x00,0x00,0x00,0x00,0x00,0x00,0x00,0x00,0x00,0x00,0x00,0x00,0x00,0x00,0x00,0x00,0x00,0x00,0x00,0x00,0x00,0x00,0x00,0x00,0x00,0x00,0x00,0x00,0x00,0x00,0x00,0x00,0x00,0x00,0x00,0x00,0x00,0x00,0x00,0x00,0x00,0x00,0x00,0x00,0x00,0x00,0x00,0x00,0x00,0x00,0x00,0x00,0x00,0x00,0x00,0x00,0x00,0x00,0xFF,0x00,0x00,0x00,0x00,0x00,0x00,0x00,0x00,0x00,0x00,0x00,0x00,0x00,0x00,0x00,0x00,0x00,0x00,0x00,0x00,0x00,0x00,0x00,0x00,0x00,0x00,0x00,0x00,0x00, 
// 		0x00,0x00,0x00,0x00,0x00,0x00,0x00,0x00,0x00,0x00,0x00,0x00,0x00,0x00,0x00,0x00,0x00,0x00,0x00,0x00,0x00,0x00,0x00,0x00,0x00,0x00,0x00,0x00,0x00,0x00,0x00,0x00,0x00,0x00,0x00,0x00,0x00,0x00,0x00,0x00,0x00,0x00,0x00,0x00,0x00,0x00,0x00,0x00,0x00,0x00,0x00,0x00,0x00,0x00,0x00,0x00,0x00,0x00,0x00,0x00,0x00,0x00,0x00,0x00,0x00,0x00,0x00,0x00,0x00,0x00,0x00,0x00,0x00,0x00,0x00,0x00,0x00,0x00,0x00,0x00,0x00,0x00,0x00,0x00,0x00,0x00,0x00,0x00,0x00,0x00,0x00,0x00,0x00,0x00,0x00,0x00,0x00,0x00,0xFF,0x00,0x00,0x00,0x00,0x00,0x00,0x00,0x00,0x00,0x00,0x00,0x00,0x00,0x00,0x00,0x00,0x00,0x00,0x00,0x00,0x00,0x00,0x00,0x00,0x00,0x00,0x00,0x00,0x00, 
// 		0x00,0x00,0x00,0x00,0x00,0x00,0x00,0x00,0x00,0x00,0x00,0x00,0x00,0x00,0x00,0x00,0x00,0x00,0x00,0x00,0x00,0x00,0x00,0x00,0x00,0x00,0x00,0x00,0x00,0x00,0x00,0x00,0x00,0x00,0x00,0x00,0x00,0x00,0x00,0x00,0x00,0x00,0x00,0x00,0x00,0x00,0x00,0x00,0x00,0x00,0x00,0x00,0x00,0x00,0x00,0x00,0x00,0x00,0x00,0x00,0x00,0x00,0x00,0x00,0x00,0x00,0x00,0x00,0x00,0x00,0x00,0x00,0x00,0x00,0x00,0x00,0x00,0x00,0x00,0x00,0x00,0x00,0x00,0x00,0x00,0x00,0x00,0x00,0x00,0x00,0x00,0x00,0x00,0x00,0x00,0x00,0x00,0x00,0xFF,0x00,0x00,0x00,0x00,0x00,0x00,0x00,0x00,0x00,0x00,0x00,0x00,0x00,0x00,0x00,0x00,0x00,0x00,0x00,0x00,0x00,0x00,0x00,0x00,0x00,0x00,0x00,0x00,0x00, 
// 		};

// 	CAB id;
//     char *ola = "olaaaaaaa";
//     id = open_cab("Juan", 4,32*32,img1);

//     char *msg_pointer8;
//     msg_pointer8 = cab_getmes(id);
//     printf("MESSAGE: %p, message %s\n" , msg_pointer8,msg_pointer8);
//     cab_unget(msg_pointer8,id);

//     char *buf_pointer;
//     buf_pointer = reserve(id);
//     char *mes = "aaaaaaaaa";
//     printf("BUFFER POINTER1: %p\n", buf_pointer);
//     char* mespointer = memcpy(buf_pointer + sizeof(struct buffer),mes,10); // 10 is dim
//     put_mes(buf_pointer,id);

//     char *msg_pointer9;
//     char *buf_pointer2;
//     buf_pointer2 = reserve(id);
//     char *mes2 = "bbbbb";
//     printf("BUFFER POINTER2: %p\n", buf_pointer2);
//     msg_pointer9 = cab_getmes(id);
//     printf("MESSAGE9: %p, message9 %s\n" , msg_pointer9,msg_pointer9);
//     char* mespointer2 = memcpy(buf_pointer2 + sizeof(struct buffer),mes2,10); // 10 is dim
//     put_mes(buf_pointer2,id);

//     char *msg_pointer;
//     msg_pointer = cab_getmes(id);
//     printf("MESSAGE: %p, message %s\n" , msg_pointer,msg_pointer);
//     cab_unget(msg_pointer,id);

// 	return 1;
// }
```

## src/ipa.h
```c
#ifndef IPA
#define IPA
#include <stdint.h>
#define IMGWIDTH 32

int guideLineSearch(uint8_t imageBuf[IMGWIDTH][IMGWIDTH], int16_t *pos, float *angle);
int obstCount(uint8_t imageBuf[IMGWIDTH][IMGWIDTH]);
int csaObjects(uint8_t imageBuf[IMGWIDTH][IMGWIDTH]);
//void test();

#endif
```
